## blecar_board_nrf52840/blecar_board_nrf52840_defconfig
```kconfig
# Copyright (c) 2023 Nordic Semiconductor ASA
# SPDX-License-Identifier: Apache-2.0

CONFIG_SOC_SERIES_NRF52X=y
CONFIG_SOC_NRF52840_QIAA=y
CONFIG_BOARD_BLECAR_BOARD_NRF52840=y

# Enable MPU
CONFIG_ARM_MPU=y

# Enable hardware stack protection
CONFIG_HW_STACK_PROTECTION=y

CONFIG_GPIO=y
CONFIG_PWM=y
CONFIG_ADC=y
CONFIG_SERIAL=y
CONFIG_CONSOLE=y
CONFIG_UART_CONSOLE=y
CONFIG_PINCTRL=y
CONFIG_CLOCK_CONTROL_NRF_K32SRC_XTAL=n
CONFIG_CLOCK_CONTROL_NRF_K32SRC_RC=y
```

## boards/arm/blecar_board_nrf52840/Kconfig.board
```kconfig
# Copyright (c) 2023 Nordic Semiconductor ASA
# SPDX-License-Identifier: Apache-2.0

config BOARD_BLECAR_BOARD_NRF52840
	bool "BLECar Board nRF52840"
	depends on SOC_NRF52840_QIAA
```

## boards/arm/nrf52810_blecar_board/Kconfig.board
```kconfig
config BOARD_NRF52810_BLECAR_BOARD
	bool "Custom Board auto generated by nRF Connect for VS Code"
	depends on SOC_NRF52810_QFAA
```

## boards/arm/nrf52820_blecar_board/Kconfig.defconfig
```kconfig
if BOARD_NRF52820_BLECAR_BOARD

config BOARD
	default "nrf52820_blecar_board"

config BT_CTLR
	default BT

endif # BOARD_NRF52820_BLECAR_BOARD
```

## boards/arm/nrf52832_felk_control_board/Kconfig.board
```kconfig
config BOARD_NRF52832_FELK_CONTROL_BOARD
	bool "Custom Board auto generated by nRF Connect for VS Code"
	depends on SOC_NRF52832_QFAA
```

## boards/arm/nrf52832_felk_ctrl_v4_board/Kconfig.board
```kconfig
config BOARD_NRF52832_FELK_CTRL_V4_BOARD
	bool "Custom Board auto generated by nRF Connect for VS Code"
	depends on SOC_NRF52832_QFAA
```

## boards/arm/nrf52832_felk_ctrl_v4_board/Kconfig.defconfig
```kconfig
if BOARD_NRF52832_FELK_CTRL_V4_BOARD

config BOARD
	default "nrf52832_felk_ctrl_v4_board"

config BT_CTLR
	default BT

endif # BOARD_NRF52832_FELK_CTRL_V4_BOARD
```

## boards/blecar_board_nrf52840/Kconfig.defconfig
```kconfig
# Copyright (c) 2023 Nordic Semiconductor ASA
# SPDX-License-Identifier: Apache-2.0

if BOARD_BLECAR_BOARD_NRF52840

config BOARD
	default "blecar_board_nrf52840"

config BT_CTLR
   default BT

endif
```

## boards/nrf52810_blecar_board/Kconfig.defconfig
```kconfig
if BOARD_NRF52810_BLECAR_BOARD

config BOARD
	default "nrf52810_blecar_board"

config BT_CTLR
	default BT

endif # BOARD_NRF52810_BLECAR_BOARD
```

## boards/nrf52820_blecar_board/Kconfig.board
```kconfig
config BOARD_NRF52820_BLECAR_BOARD
	bool "Custom Board auto generated by nRF Connect for VS Code"
	depends on SOC_NRF52820_QDAA
```

## boards/nrf52832_felk_control_board/Kconfig.defconfig
```kconfig
if BOARD_NRF52832_FELK_CONTROL_BOARD

config BOARD
	default "nrf52832_felk_control_board"

config BT_CTLR
	default BT

endif # BOARD_NRF52832_FELK_CONTROL_BOARD
```

## custom_nrf52840_dk/Kconfig.board
```kconfig
config BOARD_CUSTOM_NRF52840_DK
	bool "Custom Board auto generated by nRF Connect for VS Code"
	depends on SOC_NRF52840_QIAA
```

## custom_nrf52840_dk/Kconfig.defconfig
```kconfig
if BOARD_CUSTOM_NRF52840_DK

config BOARD
	default "custom_nrf52840_dk"

config BT_CTLR
	default BT

endif # BOARD_CUSTOM_NRF52840_DK
```

## nrf52810_blecar_board/nrf52810_blecar_board_defconfig
```kconfig
CONFIG_SOC_SERIES_NRF52X=y
CONFIG_SOC_NRF52810_QFAA=y
CONFIG_BOARD_NRF52810_BLECAR_BOARD=y

CONFIG_ARM_MPU=y
CONFIG_HW_STACK_PROTECTION=y

CONFIG_GPIO=y
CONFIG_PWM=y
CONFIG_ADC=y
CONFIG_SERIAL=y
CONFIG_CONSOLE=y
CONFIG_UART_CONSOLE=y
CONFIG_PINCTRL=y
CONFIG_CLOCK_CONTROL_NRF_K32SRC_XTAL=n
CONFIG_CLOCK_CONTROL_NRF_K32SRC_RC=y
```

## nrf52820_blecar_board/Kconfig
```kconfig
config BOARD_ENABLE_DCDC
    bool "DCDC mode"
    select SOC_DCDC_NRF52X
    default n
    depends on BOARD_NRF52820_BLECAR_BOARD
```

## nrf52820_blecar_board/nrf52820_blecar_board_defconfig
```kconfig
CONFIG_SOC_SERIES_NRF52X=y
CONFIG_SOC_NRF52820_QDAA=y
CONFIG_BOARD_NRF52820_BLECAR_BOARD=y

CONFIG_ARM_MPU=y
CONFIG_HW_STACK_PROTECTION=y

CONFIG_PINCTRL=y

CONFIG_GPIO=y
CONFIG_NFCT_PINS_AS_GPIOS=y

CONFIG_PWM=y
CONFIG_PWM_NRF5_SW=y

CONFIG_ADC=y

CONFIG_CLOCK_CONTROL_NRF_K32SRC_XTAL=n
CONFIG_CLOCK_CONTROL_NRF_K32SRC_RC=y
```

## nrf52832_felk_control_board/nrf52832_felk_control_board_defconfig
```kconfig
CONFIG_SOC_SERIES_NRF52X=y
CONFIG_SOC_NRF52832_QFAA=y
CONFIG_BOARD_NRF52832_FELK_CONTROL_BOARD=y

CONFIG_ARM_MPU=y
CONFIG_HW_STACK_PROTECTION=y

CONFIG_PINCTRL=y

CONFIG_GPIO=y
CONFIG_NFCT_PINS_AS_GPIOS=y
CONFIG_PWM=y
CONFIG_ADC=y
CONFIG_SERIAL=y
CONFIG_UART_ASYNC_API=y
CONFIG_CONSOLE=y
CONFIG_UART_CONSOLE=y
CONFIG_CLOCK_CONTROL_NRF_K32SRC_XTAL=n
CONFIG_CLOCK_CONTROL_NRF_K32SRC_RC=y
```

## nrf52832_felk_ctrl_board/nrf52832_felk_ctrl_board_defconfig
```kconfig
CONFIG_SOC_SERIES_NRF52X=y
CONFIG_SOC_NRF52832_QFAA=y
CONFIG_BOARD_NRF52832_FELK_CTRL_BOARD=y

CONFIG_ARM_MPU=y
CONFIG_HW_STACK_PROTECTION=y

CONFIG_PINCTRL=y
```
